## fs/bs2fat/Kconfig
```kconfig
config BS2_FAT
    tristate "BS2 Fat"
    depends on MMU && RUST
    default n
    help
      Enables the rust implementation of fat.
```

## fs/bs2ramfs/Kconfig
```kconfig
config BS2_RAMFS
    tristate "BS2 ramfs"
    depends on MMU && RUST
    default n
    help
      Enables the rust implementation of ramfs.
```
